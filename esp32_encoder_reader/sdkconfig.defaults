## esp32_encoder_reader/sdkconfig.defaults
```kconfig
# ESP32-S3 编码器读取系统配置

# 目标芯片
CONFIG_IDF_TARGET="esp32s3"

# CPU 频率设置为最高
CONFIG_ESP_DEFAULT_CPU_FREQ_MHZ_240=y

# Flash 配置
CONFIG_ESPTOOLPY_FLASHSIZE_4MB=y
CONFIG_ESPTOOLPY_FLASHFREQ_80M=y

# UART 配置
CONFIG_UART_ISR_IN_IRAM=y

# FreeRTOS 配置
CONFIG_FREERTOS_HZ=1000
CONFIG_FREERTOS_UNICORE=n
CONFIG_FREERTOS_TIMER_TASK_PRIORITY=5

# ESP-NOW / WiFi 配置
CONFIG_ESP_WIFI_STATIC_RX_BUFFER_NUM=10
CONFIG_ESP_WIFI_DYNAMIC_RX_BUFFER_NUM=32
CONFIG_ESP_WIFI_TX_BUFFER_TYPE=1
CONFIG_ESP_WIFI_DYNAMIC_TX_BUFFER_NUM=32

# 日志级别 (发布时可改为 WARN)
CONFIG_LOG_DEFAULT_LEVEL_INFO=y

# 优化选项
CONFIG_COMPILER_OPTIMIZATION_PERF=y

# 看门狗
CONFIG_ESP_TASK_WDT_TIMEOUT_S=10
CONFIG_ESP_INT_WDT_TIMEOUT_MS=300

# 电源管理 (禁用以获得稳定的实时性能)
CONFIG_PM_ENABLE=n
```
